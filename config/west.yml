## config/west.yml
```yaml
manifest:
  remotes:
    - name: zmkfirmware
      url-base: https://github.com/zmkfirmware
    - name: dgct-fork
      url-base: https://github.com/dgct
    - name: carrefinho
      url-base: https://github.com/carrefinho
    - name: caksoylar
      url-base: https://github.com/caksoylar
    - name: urob
      url-base: https://github.com/urob
  projects:
    - name: zmk
      remote: dgct-fork
      revision: fix-pm-zephyr-4.1  # Tracks main + the deep sleep fixes
      import: app/west.yml
    - name: forager-zmk-module
      remote: carrefinho
      revision: main
    - name: zmk-rgbled-widget
      remote: caksoylar
      revision: main
    - name: zmk-auto-layer
      remote: urob
      revision: main
  self:
    path: config
```
